## src/mainboard/gigabyte/ga-h55m-s2/Kconfig
```kconfig
# SPDX-License-Identifier: GPL-2.0-only

if BOARD_GIGABYTE_GA_H55M_S2

config BOARD_SPECIFIC_OPTIONS
	def_bool y
	select NORTHBRIDGE_INTEL_IRONLAKE
	select SOUTHBRIDGE_INTEL_IBEXPEAK
	select SUPERIO_ITE_IT8720F
	select AZALIA_USE_LEGACY_VERB_TABLE
	select BOARD_ROMSIZE_KB_1024
	select INTEL_INT15
	select HAVE_ACPI_RESUME
	select HAVE_ACPI_TABLES
	select MAINBOARD_HAS_LIBGFXINIT
	select SERIRQ_CONTINUOUS_MODE

config MAINBOARD_DIR
	default "gigabyte/ga-h55m-s2"

config MAINBOARD_PART_NUMBER
	default "GA-H55M-S2"

endif
```

## src/mainboard/gigabyte/ga-h55m-s2/Kconfig.name
```kconfig
## SPDX-License-Identifier: GPL-2.0-only

config BOARD_GIGABYTE_GA_H55M_S2
	bool "GA-H55M-S2"
```
